## main/boards/mayi-s3-lcd/sdkconfig.defaults.board
```kconfig
CONFIG_BOARD_TYPE_MAYI_S3_LCD=y

CONFIG_USE_AFE_WAKE_WORD=n
CONFIG_USE_WAKE_WORD_DETECT=n
CONFIG_USE_AUDIO_PROCESSOR=n
CONFIG_SR_WN_WN9_NIHAOXIAOZHI_TTS=n

CONFIG_USE_DEVICE_AEC=y

CONFIG_SPEAKING_FIRST_MUTE_TIME=60

CONFIG_LV_OS_FREERTOS=y
CONFIG_LV_USE_GIF=y
CONFIG_LV_GIF_CACHE_DECODE_DATA=y
```

## sdkconfig.defaults.esp32s3
```kconfig
CONFIG_ESPTOOLPY_FLASHSIZE_16MB=y
CONFIG_ESPTOOLPY_FLASHMODE_QIO=y

CONFIG_ESP_DEFAULT_CPU_FREQ_MHZ_240=y

CONFIG_SPIRAM=y
CONFIG_SPIRAM_MODE_OCT=y
CONFIG_SPIRAM_SPEED_80M=y
CONFIG_SPIRAM_MALLOC_ALWAYSINTERNAL=4096
CONFIG_SPIRAM_MALLOC_RESERVE_INTERNAL=49152
CONFIG_SPIRAM_MEMTEST=n
CONFIG_MBEDTLS_EXTERNAL_MEM_ALLOC=y

# Disable TLS verification
# Production needs to include specific cert chain you care about
CONFIG_ESP_TLS_INSECURE=y
CONFIG_ESP_TLS_SKIP_SERVER_CERT_VERIFY=y

CONFIG_ESP32S3_INSTRUCTION_CACHE_32KB=y
CONFIG_ESP32S3_DATA_CACHE_64KB=y
CONFIG_ESP32S3_DATA_CACHE_LINE_64B=y

CONFIG_SR_WN_WN9_NIHAOXIAOZHI_TTS=y

CONFIG_ESP_SYSTEM_EVENT_TASK_STACK_SIZE=4096

CONFIG_BOARD_TYPE_MAYI_S3_LCD=y

CONFIG_USE_AFE_WAKE_WORD=y
CONFIG_USE_WAKE_WORD_DETECT=y
CONFIG_USE_AUDIO_PROCESSOR=y
CONFIG_SR_WN_WN9_NIHAOXIAOZHI_TTS=n

CONFIG_USE_DEVICE_AEC=y

CONFIG_SPEAKING_FIRST_MUTE_TIME=60

CONFIG_LV_OS_FREERTOS=y
CONFIG_LV_USE_GIF=y
CONFIG_LV_GIF_CACHE_DECODE_DATA=y
```
